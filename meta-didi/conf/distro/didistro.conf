## meta-didi/conf/distro/didistro.conf
```bitbake
DISTRO_NAME = "Didistro"
DISTRO_VERSION = "0.0.0"

# Raspberry /boot/config.txt
ENABLE_UART = "1"
RPI_USE_U_BOOT = "1"

# SD partitioning
WKS_FILE = "didi-sdimage.wks"

# SyVint not test console - due to readonly-filesystem
SERIAL_CONSOLES_CHECK = ""

# Core Image
EXTRA_IMAGE_FEATURES += " \
    read-only-rootfs \
"

CORE_IMAGE_EXTRA_INSTALL += " \
    python3 \
    python3-didistro-tools \
    overlay \
"
```

## meta-didi/conf/layer.conf
```bitbake
# We have a conf and classes directory, add to BBPATH
BBPATH .= ":${LAYERDIR}"

# We have recipes-* directories, add to BBFILES
BBFILES += "${LAYERDIR}/recipes-*/*/*.bb \
            ${LAYERDIR}/recipes-*/*/*.bbappend"

BBFILE_COLLECTIONS += "meta-didi"
BBFILE_PATTERN_meta-didi = "^${LAYERDIR}/"
BBFILE_PRIORITY_meta-didi = "6"

LAYERDEPENDS_meta-didi = "core"
LAYERSERIES_COMPAT_meta-didi = "kirkstone"
```

## meta-didi/conf/machine/didi-pi-4.conf
```bitbake
# Didistro supported Machine: Raspberry Pi 4 Model B

require conf/machine/raspberrypi4-64.conf


# Enable 2 Side toggle in u-boot

# 2 sides toggle files
IMAGE_BOOT_FILES:append = " didistro/* "

do_image_wic[depends] += " \
    python3-didistro-tools:do_deploy \
"

# Dynamic rootfs cmdline rootfs
# CMDLINE_ROOTFS ?= "root=@@REPLACE_ROOTFS@@ ${CMDLINE_ROOT_FSTYPE} rootwait"
```

## meta-didi/wic/didi-sdimage.wks
```
# short-description: Create Raspberry Pi SD card image
# long-description: Creates a partitioned SD card image for use with
# Raspberry Pi. Boot files are located in the first vfat partition.

part /boot --source bootimg-partition --ondisk mmcblk0 --fstype=vfat --label bootfs --active --align 4096 --size 20
part / --source rootfs --ondisk mmcblk0 --fstype=ext4 --label rootfs1 --align 4096 --exclude-path=didistro/
part / --source rootfs --ondisk mmcblk0 --fstype=ext4 --label rootfs2 --align 4096 --exclude-path=didistro/
part /overlay --ondisk mmcblk0 --fstype=ext4 --label overlay --align 4096 --size 1G
```
